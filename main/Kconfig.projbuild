## main/Kconfig.projbuild
```kconfig
menu "Centrale termica"
config CT_BOARD_4RELAY
    bool "Scheda ESP32 Relay X4 (rele 1-4 su GPIO 32,33,25,26)"
    depends on IDF_TARGET_ESP32
    default y
    help
        Pinout della scheda ESP32 Relay X4 documentata da ESPHome Devices.
        Tutti e quattro i rele si comandano indipendentemente tramite MQTT.
config CT_RELAY_ACTIVE_LEVEL
    int "Livello GPIO di attivazione rele (0/1, verificare scheda)"
    depends on CT_BOARD_4RELAY
    range 0 1
    default 1
config CT_FLOW_CLOSE_MS
    int "Conferma chiusura flussostato (ms, apertura immediata al campionamento)"
    range 0 1000
    default 50
config CT_STATUS_LED_GPIO
    int "GPIO LED semplice di stato (-1 disabilita)"
    range -1 48
    default 23 if CT_BOARD_4RELAY
    default -1
config CT_STATUS_LED_ACTIVE_LEVEL
    int "Livello di accensione LED semplice (0/1)"
    range 0 1
    default 1
config CT_WIFI_SSID
    string "SSID Wi-Fi"
    default ""
config CT_WIFI_PASSWORD
    string "Password Wi-Fi"
    default ""
config CT_MQTT_URI
    string "Broker MQTT (mqtt://indirizzo:1883)"
    default "mqtt://192.168.1.10:1883"
config CT_MQTT_USER
    string "Utente MQTT"
    default ""
config CT_MQTT_PASSWORD
    string "Password MQTT"
    default ""
config CT_SETUP_AP_PASSWORD
    string "Password fissa rete AP di setup (8-63 caratteri)"
    default "CentraleSetup2026"
    help
        Resta uguale dopo riavvio, reset configurazione ed erase-flash.
        Modificandola occorre rigenerare il QR Wi-Fi stampato.
config CT_SETUP_BUTTON_GPIO
    int "GPIO pulsante AP/reset attivo basso (-1 disabilita)"
    range -1 48
    default 0 if IDF_TARGET_ESP32
    default 10 if IDF_TARGET_ESP32C6
    default 9
config CT_RGB_GPIO
    int "GPIO LED RGB WS2812 (-1 disabilita)"
    range -1 48
    default 8 if IDF_TARGET_ESP32C6
    default -1
config CT_RGB_BRIGHTNESS
    int "Luminosita LED RGB (1-255)"
    range 1 255
    default 16
config CT_GPIO
    int "GPIO dati 1-Wire (verificare sulla scheda)"
    range 0 48
    default 4
config CT_PERIOD
    int "Intervallo letture (secondi)"
    range 5 3600
    default 15
endmenu
```

## sdkconfig.defaults.esp32
```kconfig
CONFIG_ESPTOOLPY_FLASHSIZE_4MB=y
CONFIG_PARTITION_TABLE_CUSTOM=y
CONFIG_PARTITION_TABLE_CUSTOM_FILENAME="partitions.csv"
CONFIG_BOOTLOADER_APP_ROLLBACK_ENABLE=y
CONFIG_CT_BOARD_4RELAY=y
CONFIG_CT_RGB_GPIO=-1
CONFIG_CT_STATUS_LED_GPIO=23
CONFIG_CT_FLOW_GPIO=22
CONFIG_CT_FLOW_RELAY=4
```
